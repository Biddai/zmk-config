## boards/shields/nicepad/Kconfig.defconfig
```kconfig
if SHIELD_NICEPAD

config ZMK_KEYBOARD_NAME
    default "Nicepad"

if ZMK_DISPLAY

config I2C
    default y

config SSD1306
    default y

endif # ZMK_DISPLAY

config ZMK_DISPLAY_STATUS_SCREEN_CUSTOM
    select LV_USE_IMG
    select LV_USE_CANVAS

config LV_Z_MEM_POOL_SIZE
    default 4096 if ZMK_DISPLAY_STATUS_SCREEN_CUSTOM

if LVGL

config LV_Z_VDB_SIZE
    default 64

config LV_DPI_DEF
    default 148

config LV_Z_BITS_PER_PIXEL
    default 1

choice LV_COLOR_DEPTH
    default LV_COLOR_DEPTH_1
endchoice

endif # LVGL

endif
```
